;*******************************************************************************************************************************
;Universidad del valle
;Prelab_3.asm
;Autor: Albert Vandercam Hart
;Hardware ATmega328P
;Creado: 31/01/2024
;*******************************************************************************************************************************
; ENCABEZADO
;*******************************************************************************************************************************
.include "M328PDEF.inc"
.CSEG
.ORG 0x0000
JMP MAIN
.ORG 0x0008
JMP MODOS
.ORG 0x0020
JMP timmer
;*******************************************************************************************************************************
; STACK POINTER
;*******************************************************************************************************************************
MAIN:
	LDI R16, LOW(RAMEND)
	OUT SPL,R16
	LDI R17, HIGH(RAMEND)
	OUT SPH, R17
;*******************************************************************************************************************************
; CONFIGURACI[ON
;*******************************************************************************************************************************
setup:
	LDI R16, (1<<CLKPCE) ; aqui se habilita para que se pueda  configurar
	STS CLKPR, R16
	LDI R16, 0b0000_0001 ; A 4Mhz
	STS CLKPR, R16
	;:SE CONFIGURA EL PRESCALER
	call prescaler1
	 ; REGRESAR AL MAIN LOOP
	; ACTIVAR LOS PUERTOS
	;ACTIVAR PUERTOS C
	LDI R16,0XC3 ; CONFIUGURAR SI SON ENTRADA: 1PULL UP, SI ES SALIDA 1 5V
	OUT DDRC, R16 ;SE CONFIGURARON LOS PINES DE OUTPUTS/INPUTS, 1 SALIDA 0  ENTRADA
	LDI R17,0x3C
	OUT PORTC, R17
	; ACTIVAR PUERTOS B
	LDI R16, 0xFF 
	OUT DDRB, R16 ;SE CONFIGURARON LOS PINES DE OUTPUTS/INPUTS 1 SALIDA 0  ENTRADA
	LDI R17, 0x00 ; CONFIUGURAR SI SON ENTRADA: 1PULL UP, SI ES SALIDA 1 5V
	OUT PORTB, R17
	;ACTIVAR PUERTOS D
	LDI R16, 0xFF
	LDI R17, 0x00
	OUT DDRD, R16 ;SE CONFIGURARON LOS PINES DE OUTPUTS/INPUTS 1 SALIDA 0  ENTRADA
	OUT PORTD, R17
	; AQUÍ SE DESACTIVAN EL RX Y TX
	LDI R16, 0x00
	STS UCSR0B, R16
	; ACTIVAR LAS INTERRUPCIONES  Y LAS  DEL TIMMER 0
	LDI R16, (1<<PCIE1) ; ACTIVAR QUE SEA EL PORTC EL QUE TENGA INTERUPCIONES EN EL TIMMER 0
	STS PCICR, R16
	LDI R16, (1<<PCINT10)
	STS PCMSK1, R16
	;ACTIVAR LAS INTERRUCCIONES DEL  TIMMER
	LDI R16, (1<<TOIE0)
	STS TIMSK0, R16
	 ; ACTIVAR LAS INTERUPCIONES
	 
	CLR R0
	CLR R1
	CLR R2
	CLR R3
	CLR R4
	CLR R5
	CLR R6
	CLR R7
	CLR R8
	CLR R9
	CLR R10
	CLR R16
	CLR R17
	CLR R18
	CLR R19
	CLR R20
	CLR R21
	CLR R22
	CLR R23
	CLR R24
	CLR R25
	CLR R26
	CLR R27
	CLR R28
	CLR R29
	CLR R30
	; AQUI SE CONFIGURA PARA  QUE LA FECHA INICIE EN 01/01
	LDI R16, 1
	MOV R10, R16
	LDI R16, 0
	MOV R11, R16
	LDI R16, 1
	MOV R12, R16
	LDI R16, 0
	MOV R13, R16
	LDI R16, 1
	MOV R15, R16
	; AQUI SE ACABA LA CONFIGURACIÓN 

	/* REGISTROS Y SUS USOS
	R0 CONTADOR MINUTOS UNIDADESA
	R1 CONTADOR MINUTOS DECENA
	R2 CONTADOR HORAS UNIDADES
	R3 CONTADOR HORA DECENAS
	R4  CONTADOR SEGUNDOS
	R5 CONTADOR TRANSISTORES
	R6 CONTADOR MODOS
	R7 DEMUX DE TRANSIS
	R8 BIT DE CONFIGURAR
	R9 DIGITO PARA CAMBIAR HORA
	R10 CONTADOR DE DIAS UNIDADES
	R11 CONTADOR DE DIAS DECENAS
	R12 CONTADOR DE MESES UNIDADES
	R13 CONTADOR DE MESES DECENAS
	R14 CONTADOR GENERAL DE DÍAS
	R15 CONTADOR GENERAL DE MESES
	R16 MOVER REGISTROS 
	R17 MOVER REGISTROS
	R18 ES UN ANTIREBOTE DEL  LOS SUMADORES O RESTADORES
	19 MOVER REGISTROS
	R20 HACER PORT A LOS DISPLAYS
	R21 CONTADOR GENERAL DE DIAS
	R22 CONTADOR MIN ALARMA
	R23 CONTADOR DECENAS ALARMA
	R24 CONTADOR HORAS
	R25 CONTADOR DECENAS HORAS
	*/
	SEI
	CBI PORTB, PB5
	LDI R16, 1
	MOV R14, R16

	; CONFIGURACIÓN DEL DISPLAY PA QUE EMPIECE EN 0
MAIN_LOOP:
MOV R16, R6
CPI R16, 0
BREQ HORA
CPI R16, 1
BREQ SALTA_CAMBIAR_HORA
CPI R16, 2
BREQ SALTA_FECHA
CPI R16, 3
BREQ SALTA_CAMBIAR_FECHA
CPI R16, 4
BREQ SALTA_ALARMA
JMP MAIN_LOOP
/*EMPIEZA MOSTRAR SOLAMENTE LA HORA**************************************************************************************************************************************************/
NUMEROD: .DB  0xF9, 0x21, 0xBA, 0xAB, 0x63, 0xCB, 0xDB, 0xA1,0xFB, 0xEB
BLOQUE_HORA:
	MOV R16, R5
	CPI R16, 1
	BREQ SALTAR_TRANCIS
	CPI R26, 60
	BREQ SALTA_HORA	
	MOV R16, R6
	CPI R16, 0
	BREQ SALIR1
	CPI R16, 1
	BREQ SELECCIONAR_MODIFICACION


	JMP MAIN_LOOP
HORA:
	CBI PORTC, PC1
	CBI PORTC, PC0
	SBI PORTB, PB4
	JMP BLOQUE_HORA
SALIR1:
	MOV R16, R6
	CPI R16,0
	BRNE  MAIN_LOOP
	MOV R16, R14	
	CPI R16, 0
	BREQ SALTAR_SONAR_ALARMA1_R
	JMP HORA
	/*FIN DE SOLO MOSTRAR LA HORA************************************************************************************************************************************************************/
	/* BLOQUE DE SALTO *************************************************************************************************************************************************/
	SALTAR_TRANCIS:
		JMP TRANCISTORES
	SALTA_HORA:
		JMP RELOJ
	SALTA_CAMBIAR_HORA:
		JMP	CAMBIAR_HORA
	SALTA_FECHA:
		JMP FECHA
	SALTA_CAMBIAR_FECHA:
		JMP CAMBIAR_FECHA
	SALTA_ALARMA:
		JMP ALARMA
	SALTAR_SONAR_ALARMA1_R:
		JMP SONAR_ALARMA1
	/* EMPIEZA LA CONFIGURACIÓN PARA PODER CAMBIAR LA HORA**********************************************************************************************************************/
CAMBIAR_HORA:
	SBI PORTC, PC0
	JMP BLOQUE_HORA
SELECCIONAR_MODIFICACION:
	CPI R16, 1
	BRNE MAIN_LOOP
	SBIS PINC, PC3
	JMP SELECCIONAR_D
	SBIS PINC, PC4
	JMP  MENU_SUMADOR
	SBIS PINC, PC5
	JMP MENU_RESTADOR
	CLR R18
	MOV R16, R14	
	CPI R16, 0
	BREQ SALTAR_SONAR_ALARMA1_R
	JMP CAMBIAR_HORA
SELECCIONAR_D:

	SBIC PINC, PC3
	JMP CAMBIAR_HORA
	INC R9
	MOV R16, R9
	CPI R16, 2
	BRSH LIMPIAR_SELECCIONADOR
	JMP CAMBIAR_HORA

	
LIMPIAR_SELECCIONADOR:
	CLR R9
	JMP CAMBIAR_HORA

MENU_SUMADOR:	
	CPI R18, 0
	BRNE CAMBIAR_HORA
	INC R18
	MOV R16, R9
	CPI R16, 0
	BREQ  SUMAR_U
	CPI R16,1
	BREQ SUMAR_H
	JMP CAMBIAR_HORA
SUMAR_U:
	INC R0
	MOV R16, R0
	MOV R17, R1
	CPI  R16, 10
	BRSH SUMARUD
	CPI R17, 6
	BRSH LIMPIAR_U
	JMP CAMBIAR_HORA
SUMARUD:
	CLR R0
	INC R1
	JMP CAMBIAR_HORA
LIMPIAR_U:
	CLR R0
	CLR R1
	JMP CAMBIAR_HORA
LIMPIAR_H:
	CLR R2
	CLR R3
	JMP CAMBIAR_HORA
REINICIARU:
	CLR R0
	JMP CAMBIAR_HORA
SUMAR_H:
	INC R2
	MOV R16, R2
	MOV R17, R3
	CPI R16, 10
	BRSH SUM_DH
	CPI R17, 2
	BREQ VERIFICA_24
	JMP CAMBIAR_HORA
VERIFICA_24:
	CPI R16, 4
	BRSH SUMAR_DIA
	JMP CAMBIAR_HORA
SUMAR_DIA:
	CLR R2
	CLR R3
	INC R10
	MOV R16, R10
	CPI  R16, 10
	BREQ SUMAR_DIA_D
	JMP CAMBIAR_HORA
SUMAR_DIA_D:
	CLR R10
	INC R11
	MOV R16, R11
	CPI R16, 10
	BREQ BORRAR_DIAS
BORRAR_DIAS:
	CLR R11
	JMP MAIN_LOOP
SUM_DH:
	CLR R2
	INC R3
	JMP CAMBIAR_HORA
MENU_RESTADOR:
	CPI R18, 0
	BRNE SALTA_CAMBIO_HORA
	INC R18
	MOV R16, R9
	CPI R16, 0
	BREQ  RESTAR_U
	CPI R16,1
	BREQ RESTAR_H
	CPI R16,2
	JMP CAMBIAR_HORA
RESTAR_U:
	MOV R16, R0
	MOV R17, R1
	CPI R16, 0
	BREQ RESTAR_D
	DEC R0
	JMP SALTA_CAMBIO_HORA
RESTAR_D:
	LDI R16, 9
	MOV R0, R16
	CPI R17, 0
	BREQ EMPEZAR_DE_NUEVOU
	DEC R1
	JMP SALTA_CAMBIO_HORA
EMPEZAR_DE_NUEVOU:
	LDI R17, 5
	MOV R1, R17
	JMP SALTA_CAMBIO_HORA
RESTAR_H:
	MOV R16, R2
	MOV R17, R3
	CPI R16, 0
	BREQ RESTAR_DH
	DEC R2
	JMP SALTA_CAMBIO_HORA
RESTAR_DH:
	LDI R16, 9
	MOV R2, R16
	CPI R17,0
	BREQ EMPEZAR_DE_NUEVOH
	DEC R3
	JMP SALTA_CAMBIO_HORA
EMPEZAR_DE_NUEVOH:
	LDI R16, 3
	LDI R17,2
	MOV R2, R16
	MOV R3, R17
	JMP SALTA_CAMBIO_HORA
	/* SALTOS DEL CAMBIO DE HORA******************************************************************************************************************************************************/
SALTA_CAMBIO_HORA:
	JMP CAMBIAR_HORA
	/* FIN DEL MODO CONFIGURAR HORA **************************************************************************************************************************************************************************************************/
FECHA:
	CLR R9
	CBI PORTB, PB4
	CBI PORTC, PC0
	SBI PORTC, PC1
	MOV R16, R6
	CPI R16, 2
	BRNE SALTA_MAIN_LOOP
	CPI R26, 60
	BREQ  SALTA_RELOJ_FECHA
	MOV R16, R5
	CPI R16, 1
	BREQ SALTO_TRANS_FECHA
	MOV R16, R14	
	CPI R16, 0
	BREQ SALTAR_SONAR_ALARMA1_R
	JMP FECHA
	/*SALTOS DE LA FECHA****************************************************************************************************************************************************************************/
	SALTA_MAIN_LOOP:
		JMP MAIN_LOOP
	SALTA_RELOJ_FECHA:
		JMP RELOJ
	SALTO_TRANS_FECHA:
		JMP TRANCISTORES
	SALTAR_SONAR_ALARMA1_F:
		JMP SONAR_ALARMA1
/* AQUI TERMINA LA FECHA********************************************************************************************************************************************************************************************************/
/* AQUI EMPEIZA CONFI FECHA********************************************************************************************************************************************************************************************************/

CAMBIAR_FECHA:
	SBI PORTC, PC0
	MOV R16, R6
	CPI R16, 3
	BRNE SALTA_MAIN_LOOP
	CPI R26, 60
	BREQ  SALTA_RELOJ_FECHA
	MOV R16, R5
	CPI R16, 1
	BREQ SALTO_TRANS_FECHA
	SBIS PINC, PC3
	JMP SELECCIONAR_D_F
	SBIS PINC, PC4
	JMP MENU_SUMADOR_F
	SBIS PINC, PC5
	JMP MENU_RESTADOR_F
	CLR R18
	MOV R16, R14	
	CPI R16, 0
	BREQ SALTAR_SONAR_ALARMA1_F
	JMP CAMBIAR_FECHA
MENU_SUMADOR_F:
	CPI R18, 0
	BRNE CAMBIAR_FECHA
	INC R18
	MOV R16, R9
	CPI R16, 0
	BREQ  MENU_MESES1
	CPI R16,1
	BREQ SALTO_SUMAR_M_F
	JMP CAMBIAR_FECHA
/* SALTOS DEL MENU DE CAMBIAR FECHA******************************************************************************************************************************/
SALTO_SUMAR_M_F:
	JMP SUMAR_M_F
/* TERMINAN LOS SALTOS**************************************************************************************************************************************************/
MENU_MESES1:
	MOV R19, R15
	CPI R19, 1
	BREQ MESES_31F
	CPI R19,2
	BREQ MESES_28F
	CPI R19,3
	BREQ MESES_31F
	CPI R19, 4
	BREQ MESES_30F
	CPI R19,5
	BREQ MESES_31F
	CPI R19, 6
	BREQ MESES_30F
	CPI R19, 7
	BREQ MESES_31F
	CPI R19, 8
	BREQ MESES_31F
	CPI R19, 9
	BREQ MESES_30F
	CPI R19,10
	BREQ MESES_31F
	CPI R19, 11
	BREQ MESES_30F
	CPI R19, 12
	BREQ MESES_31F
	JMP CAMBIAR_FECHA
MESES_28F:
	INC R10
	MOV R16, R10
	CPI R16, 10
	BREQ SUM_DIA_DF
	CPI R16, 9
	BRSH VERIFICAR_28F
	JMP MAIN_LOOP
VERIFICAR_28F:
	MOV R16, R11
	CPI R16, 2
	BREQ LIMPIAR_MES
	JMP CAMBIAR_FECHA
MESES_30F:
	INC R10
	MOV R16, R10
	CPI R16, 10
	BREQ SUM_DIA_DF
	CPI R16, 1
	BRSH VERIFICAR_30F
	JMP CAMBIAR_FECHA
VERIFICAR_30F:
	MOV R16, R11
	CPI R16, 3
	BRSH LIMPIAR_MES
	JMP  CAMBIAR_FECHA
MESES_31F:
	INC R10
	MOV R16, R10
	CPI R16, 10
	BREQ SUM_DIA_DF
	CPI R16, 2
	BRSH VERIFICAR_31F
	JMP CAMBIAR_FECHA
VERIFICAR_31F:
	MOV R16, R11
	CPI R16, 3
	BREQ LIMPIAR_MES
	JMP  CAMBIAR_FECHA
LIMPIAR_MES:
	LDI R16, 1
	MOV R10, R16
	CLR R11
	JMP CAMBIAR_FECHA
SUM_DIA_DF:
	CLR R10
	INC R11
	JMP CAMBIAR_FECHA
SUMAR_M_F:
	INC R15
	INC R12
	MOV R16, R12
	CPI R16, 10
	BREQ SUMAR_MD
	CPI R16, 3
	BREQ VERIFICAR_ANO_NUEVO
	JMP CAMBIAR_FECHA
SUMAR_MD:
	CLR R12
	INC R13
	JMP CAMBIAR_FECHA
VERIFICAR_ANO_NUEVO:
	MOV R16, R13
	CPI R16, 1
	BREQ ANO_NUEVO_CUMPLIDO
	JMP CAMBIAR_FECHA
ANO_NUEVO_CUMPLIDO:
	LDI R16, 1
	MOV R12, R16
	CLR R13
	JMP CAMBIAR_FECHA
MENU_RESTADOR_F:
	CPI R18, 0
	BRNE SALTO_CAMBIAR_FECHA2
	INC R18
	MOV R16, R9
	CPI R16, 0
	BREQ MENU_MESES_R
	CPI R16, 1
	BREQ  SALTO_RESTAR_MD
	JMP CAMBIAR_FECHA
SALTO_CAMBIAR_FECHA2:
	JMP CAMBIAR_FECHA
SALTO_RESTAR_MD:
	JMP RESTAR_MD
MENU_MESES_R:
	MOV R19, R15
	CPI R19, 1
	BREQ SALTO_MESES31R
	CPI R19,2
	BREQ SALTO_MESES_28R
	CPI R19,3
	BREQ SALTO_MESES31R
	CPI R19, 4
	BREQ SALTO_MESES_30R
	CPI R19,5
	BREQ SALTO_MESES31R
	CPI R19, 6
	BREQ SALTO_MESES_30R
	CPI R19, 7
	BREQ SALTO_MESES31R
	CPI R19, 8
	BREQ SALTO_MESES31R
	CPI R19, 9
	BREQ SALTO_MESES_30R
	CPI R19,10
	BREQ SALTO_MESES31R
	CPI R19, 11
	BREQ SALTO_MESES_30R
	CPI R19, 12
	BREQ MESES_31FR
	JMP CAMBIAR_FECHA
SALTO_MESES_28R:
	JMP MESES_28FR
SALTO_MESES_30R:
	JMP MESES_30FR
SALTO_MESES31R:
	JMP MESES_31FR
MESES_28FR:
	MOV R16, R10
	CPI R16, 0
	BREQ RESTAR_DD_28
	CPI R16, 1
	BREQ VERIFICA_28R
	DEC R10
	JMP CAMBIAR_FECHA
VERIFICA_28R:
	MOV R16, R11
	CPI R16,0
	BREQ CARGAR_VALORES_28
	DEC R10
	JMP CAMBIAR_FECHA
RESTAR_DD_28:
	DEC R11
	LDI R16, 9
	MOV R10, R16
	JMP CAMBIAR_FECHA
CARGAR_VALORES_28:
	LDI R16, 8
	MOV R10, R16
	LDI R16, 2
	MOV R11, R16
	JMP CAMBIAR_FECHA
MESES_30FR:
	MOV R16, R10
	CPI R16, 0
	BREQ RESTAR_DD_30
	CPI R16, 1
	BREQ VERIFICA_30R
	DEC R10
	JMP CAMBIAR_FECHA
VERIFICA_30R:
	MOV R16, R11
	CPI R16,0
	BREQ CARGAR_VALORES_30
	DEC R10
	JMP CAMBIAR_FECHA
RESTAR_DD_30:
	DEC R11
	LDI R16, 9
	MOV R10, R16
	JMP CAMBIAR_FECHA
CARGAR_VALORES_30:
	LDI R16, 0
	MOV R10, R16
	LDI R16, 3
	MOV R11, R16
	JMP CAMBIAR_FECHA
MESES_31FR:
	MOV R16, R10
	CPI R16, 0
	BREQ RESTAR_DD_31
	CPI R16, 1
	BREQ VERIFICA_31R
	DEC R10
	JMP CAMBIAR_FECHA
VERIFICA_31R:
	MOV R16, R11
	CPI R16,0
	BREQ CARGAR_VALORES_31
	DEC R10
	JMP CAMBIAR_FECHA
RESTAR_DD_31:
	DEC R11
	LDI R16, 9
	MOV R10, R16
	JMP CAMBIAR_FECHA
CARGAR_VALORES_31:
	LDI R16, 1
	MOV R10, R16
	LDI R16, 3
	MOV R11, R16
	JMP CAMBIAR_FECHA
RESTAR_MD:
	MOV R16, R12
	MOV R17, R13
	CPI R16, 0
	BREQ RESTAR_M_D
	CPI R16, 1
	BREQ VERIFICA_ANO_NUEVO
	DEC R12
	DEC R15
	JMP CAMBIAR_FECHA
RESTAR_M_D:
	LDI R16, 9
	MOV R12, R16
	DEC R13
	DEC R15
	JMP CAMBIAR_FECHA
VERIFICA_ANO_NUEVO:
	CPI R17, 0
	BREQ  RESTABLECER_ANO_NUEVO
	DEC R12
	DEC R15
	JMP CAMBIAR_FECHA
RESTABLECER_ANO_NUEVO:
	LDI R16, 12
	MOV R15, R16
	LDI R16, 2
	MOV R12, R16
	LDI R16, 1
	MOV R13, R16
	JMP CAMBIAR_FECHA
SELECCIONAR_D_F:
	INC R9
	MOV R16, R9
	CPI R16, 2
	BRSH SALTO_LIMPIAR_SELECCIONADOR
	JMP CAMBIAR_FECHA
/*SALTOS DEL MENU RESTADOR CAMBIAR FECHA****************************************************************************/
SALTO_CAMBIAR_FECHA:
	JMP SALTO_CAMBIAR_FECHA
SALTO_LIMPIAR_SELECCIONADOR:
	JMP LIMPIAR_SELECCIONADOR
ALARMA:
	SBI PORTB, PB4
	CBI PORTB, PB5
	MOV R16, R6
	CPI R16, 4
	BRNE SALTA_MAIN_LOOP_A
	MOV R16, R5
	CPI R16, 1
	BREQ SALTAR_TRANCISA
	CPI R26, 60
	BREQ SALTA_HORA_A
	SBIS PINC, PC3
	JMP SELECCIONAR_DA
	SBIS PINC, PC4
	JMP  MENU_SUMADORA
	SBIS PINC, PC5
	JMP MENU_RESTADORA
	CLR R18
	JMP ALARMA
	/*SALTOS DE LA ALARMA*******************************************************************************************************************************/
SALTA_MAIN_LOOP_A:
	JMP MAIN_LOOP
SALTAR_TRANCISA:
	JMP SALTAR_TRANCIS
SALTA_HORA_A:
	JMP RELOJ
SELECCIONAR_DA:
	INC R9
	MOV R16, R9
	CPI R16, 2
	BRSH LIMPIAR_SELECCIONADORA
	JMP ALARMA
LIMPIAR_SELECCIONADORA:
	CLR R9
	JMP ALARMA
MENU_SUMADORA:	
	CPI R18, 0
	BRNE ALARMA
	INC R18
	MOV R16, R9
	CPI R16, 0
	BREQ  SUMAR_UA
	MOV R16, R9
	CPI R16,1
	BREQ SUMAR_HA
	JMP ALARMA
SUMAR_UA:
	INC R22
	CPI  R22, 10
	BRSH SUMARUDA
	JMP ALARMA
SUMARUDA:
	CLR R22
	CPI R23, 5
	BREQ LIMPIAR_UA
	INC R23
	JMP ALARMA
LIMPIAR_UA:
	CLR R22
	CLR R23
	JMP ALARMA
LIMPIAR_HA:
	CLR R24
	CLR R25
	JMP ALARMA
REINICIARUA:
	CLR R22
	JMP ALARMA
SUMAR_HA:
	INC R24
	CPI R24, 10
	BRSH SUM_DHA
	CPI R25, 2
	BREQ VERIFICA_24A
	JMP ALARMA
VERIFICA_24A:
	CPI R24, 4
	BRSH LIMPIAR_DIA_ALARMA
	JMP ALARMA
LIMPIAR_DIA_ALARMA:
	CLR R24
	CLR R25
	JMP ALARMA
SUM_DHA:
	CLR R24
	INC R25
	JMP ALARMA
SALTA_ALARMA2:
	JMP ALARMA
MENU_RESTADORA:
	CPI R18, 0
	BRNE SALTA_ALARMA2
	INC R18
	MOV R16, R9
	CPI R16, 0
	BREQ  RESTAR_UA
	CPI R16,1
	BREQ RESTAR_HA
	CPI R16,2
	JMP SALTA_ALARMA
RESTAR_UA:
	CPI R22, 0
	BREQ RESTAR_DA
	DEC R22
	JMP SALTA_ALARMA
RESTAR_DA:
	LDI R22, 9
	CPI R23, 0
	BREQ EMPEZAR_DE_NUEVOUA
	DEC R23
	JMP SALTA_ALARMA
EMPEZAR_DE_NUEVOUA:
	LDI R23, 5
	JMP SALTA_ALARMA
RESTAR_HA:
	CPI R24, 0
	BREQ RESTAR_DHA
	DEC R24
	JMP SALTA_ALARMA
RESTAR_DHA:
	LDI R24, 9
	CPI R25,0
	BREQ EMPEZAR_DE_NUEVOHA
	DEC R25
	JMP SALTA_ALARMA
EMPEZAR_DE_NUEVOHA:
	LDI R24, 3
	LDI R25,2
	JMP SALTA_ALARMA
SONAR_ALARMA1:
	MOV R16, R0
	CP R16, R22
	BREQ SONAR_ALARMA2
	JMP MAIN_LOOP
SONAR_ALARMA2:
	MOV R16, R1
	CP R16,R23
	BREQ SONAR_ALARMA3
	JMP MAIN_LOOP
SONAR_ALARMA3:
	MOV R16, R2
	CP R16, R24
	BREQ SONAR_ALARMA4
	JMP MAIN_LOOP
SONAR_ALARMA4:
	MOV R16, R3
	CP R16, R25
	BREQ SONAR_ALARMA_VERDAD
	JMP MAIN_LOOP
SONAR_ALARMA_VERDAD:
	SBI PORTB, PB5
	LDI R16, 1
	MOV R14, R16
	JMP MAIN_LOOP
	/* SALTOS DEL CAMBIO DE HORA******************************************************************************************************************************************************/
	/* DEMUX DE LOS DISPLAYS**********************************************************************************************************************************************************************/
TRANCISTORES:
	CLR R5
	INC R7
	MOV R16, R7
	CPI R16, 1
	BREQ T_PRENDER_UNIDADM
	CPI R16, 2
	BREQ T_PRENDER_DECENAM
	CPI R16, 3
	BREQ T_PRENDER_UNIDADH
	CPI R16, 4
	BREQ T_PRENDER_DECENAH
	JMP MAIN_LOOP
	T_PRENDER_UNIDADM:
	CBI PORTB, PB3
	SBI PORTB, PB0
	MOV R17, R6
	CPI R17, 0
	BREQ SALTO_U_UM
	CPI R17, 1
	BREQ SALTO_U_UM
	CPI R17, 2
	BREQ SALTO_C_D
	CPI R17, 3
	BREQ SALTO_C_D
	CPI R17, 4
	BREQ SALTO_C_MA

T_PRENDER_DECENAM:
	CBI PORTB, PB0
	SBI PORTB, PB2
	MOV R17, R6
	CPI R17, 0
	BREQ SALTO_U_H
	CPI R17, 1
	BREQ SALTO_U_H
	CPI R17, 2
	BREQ SALTO_C_M
	CPI R17, 3
	BREQ SALTO_C_M
	CPI R17, 4
	BREQ SALTO_C_HA
T_PRENDER_UNIDADH:
	CBI PORTB, PB2
	SBI PORTB, PB1
	MOV R17, R6
	CPI R17, 0
	BREQ SALTO_U_UMD
	CPI R17, 1
	BREQ SALTO_U_UMD
	CPI R17, 2
	BREQ SALTO_C_DD
	CPI R17, 3
	BREQ SALTO_C_DD
	CPI R17, 4
	BREQ SALTO_C_MDA
T_PRENDER_DECENAH:
	CLR R7
	CBI PORTB, PB1
	SBI PORTB, PB3
	MOV R17, R6
	CPI R17, 0
	BREQ SALTO_U_HD
	CPI R17, 1
	BREQ SALTO_U_HD
	CPI R17, 2
	BREQ SALTO_C_MD
	CPI R17, 3
	BREQ SALTO_C_MD
	CPI R17, 4
	BREQ SALTO_C_HDA
/*SALTOS DE LOS TRANSISTORES*********************************************************************************************************************************************************/
SALTO_U_UM:
	JMP CONFIGURAR_U
SALTO_U_UMD:
	JMP CONFIGURAR_UD
SALTO_U_H:
	JMP CONFIGURAR_H
SALTO_U_HD:
	JMP CONFIGURAR_HD
	
SALTO_C_D:
	JMP CONFIGURARA_DIAS
SALTO_C_DD:
	JMP CONFIGURARA_DIAS_D
SALTO_C_M:
	JMP CONFIGURARA_MESES
SALTO_C_MD:
	JMP CONFIGURARA_MESES_D
SALTO_C_MA:
	JMP CONFIGURAR_UA
SALTO_C_MDA:
	JMP CONFIGURAR_UDA
SALTO_C_HA:
	JMP  CONFIGURAR_HA
SALTO_C_HDA:
	JMP CONFIGURAR_HDA
MOSTRAR_D:
	OUT PORTD, R20
	JMP MAIN_LOOP
CONFIGURAR_U:
	MOV R16, R0
	LDI ZH, HIGH(NUMEROD <<1)
	LDI ZL, LOW(NUMEROD <<1)
	ADD ZL, R16
	LPM R20, Z
	JMP MOSTRAR_D
CONFIGURAR_UD:
	MOV R16, R1
	LDI ZH, HIGH(NUMEROD <<1)
	LDI ZL, LOW(NUMEROD <<1)
	ADD ZL, R16
	LPM R20, Z
	JMP MOSTRAR_D
CONFIGURAR_H:
	MOV R16, R2
	LDI ZH, HIGH(NUMEROD <<1)
	LDI ZL, LOW(NUMEROD <<1)
	ADD ZL, R16
	LPM R20, Z
	JMP MOSTRAR_D
CONFIGURAR_HD:
	MOV R16, R3
	LDI ZH, HIGH(NUMEROD <<1)
	LDI ZL, LOW(NUMEROD <<1)
	ADD ZL, R16
	LPM R20, Z
	JMP MOSTRAR_D
CONFIGURARA_DIAS:
	MOV R16, R10
	LDI ZH, HIGH(NUMEROD <<1)
	LDI ZL, LOW(NUMEROD <<1)
	ADD ZL, R16
	LPM R20, Z
	JMP MOSTRAR_D
CONFIGURARA_DIAS_D:
	MOV R16, R11
	LDI ZH, HIGH(NUMEROD <<1)
	LDI ZL, LOW(NUMEROD <<1)
	ADD ZL, R16
	LPM R20, Z
	JMP MOSTRAR_D
CONFIGURARA_MESES:
	MOV R16, R12
	LDI ZH, HIGH(NUMEROD <<1)
	LDI ZL, LOW(NUMEROD <<1)
	ADD ZL, R16
	LPM R20, Z
	JMP MOSTRAR_D
CONFIGURARA_MESES_D:
	MOV R16, R13
	LDI ZH, HIGH(NUMEROD <<1)
	LDI ZL, LOW(NUMEROD <<1)
	ADD ZL, R16
	LPM R20, Z
	JMP MOSTRAR_D
	CONFIGURAR_UA:
	LDI ZH, HIGH(NUMEROD <<1)
	LDI ZL, LOW(NUMEROD <<1)
	ADD ZL, R22
	LPM R20, Z
	JMP MOSTRAR_D
CONFIGURAR_UDA:
	LDI ZH, HIGH(NUMEROD <<1)
	LDI ZL, LOW(NUMEROD <<1)
	ADD ZL, R23
	LPM R20, Z
	JMP MOSTRAR_D
CONFIGURAR_HA:
	LDI ZH, HIGH(NUMEROD <<1)
	LDI ZL, LOW(NUMEROD <<1)
	ADD ZL, R24
	LPM R20, Z
	JMP MOSTRAR_D
CONFIGURAR_HDA:
	LDI ZH, HIGH(NUMEROD <<1)
	LDI ZL, LOW(NUMEROD <<1)
	ADD ZL, R25
	LPM R20, Z
	JMP MOSTRAR_D
	/*FIN DEL DEMUX DE LOS TRANSISTORES******************************************************************************************************************************************************************************************/

RELOJ:
	CLR R26
	INC R0
	CLR R14
	MOV R16, R0
	CPI R16, 10
	BRSH SUMAR_DS
	JMP MAIN_LOOP
SUMAR_DS:
	CLR R0
	INC R1
	MOV R16, R1
	CPI R16,  6
	BRSH SUMAR_UH
	JMP MAIN_LOOP
SUMAR_UH:
	CLR R1
	INC R2
	MOV R16, R2
	CPI R16, 4
	BREQ VERICA24
	CPI R16, 10
	BRSH SUMAR_DH
	JMP MAIN_LOOP
SUMAR_DH:
	CLR R2
	INC R3
	JMP MAIN_LOOP
VERICA24:
	MOV R16, R3
	CPI R16, 2
	BRSH  MENU_MESES
	JMP MAIN_LOOP
MENU_MESES:
	CLR R2
	CLR R3
	MOV R19, R15
	CPI R19, 1
	BREQ MESES_31
	CPI R19,2
	BREQ MESES_28
	CPI R19,3
	BREQ MESES_31
	CPI R19, 4
	BREQ MESES_30
	CPI R19,5
	BREQ MESES_31
	CPI R19, 6
	BREQ MESES_30
	CPI R19, 7
	BREQ MESES_31
	CPI R19, 8
	BREQ MESES_31
	CPI R19, 9
	BREQ MESES_30
	CPI R19,10
	BREQ MESES_31
	CPI R19, 11
	BREQ MESES_30
	CPI R19, 12
	BREQ MESES_31
	JMP MAIN_LOOP
	JMP MAIN_LOOP
MESES_28:
	INC R10
	MOV R16, R10
	CPI R16, 10
	BRSH SUM_DIA_D
	CPI R16, 9
	BRSH VERIFICAR_28
	JMP MAIN_LOOP
VERIFICAR_28:
	MOV R16, R11
	CPI R16, 2
	BRSH SUMAR_MES
	JMP MAIN_LOOP
SUM_DIA_D:
	CLR R10
	INC R11
	JMP MAIN_LOOP
MESES_30:
	INC R10
	MOV R16, R10
	CPI R16, 10
	BRSH SUM_DIA_D
	CPI R16, 1
	BRSH VERIFICAR_30R
	JMP MAIN_LOOP
VERIFICAR_30R:
	MOV R16, R11
	CPI R16, 3
	BRSH SUMAR_MES
	JMP  MAIN_LOOP
MESES_31:
	INC R10
	MOV R16, R10
	CPI R16, 10
	BREQ SUM_DIA_D
	CPI  R16, 2
	BREQ VERIFICAR_31
	JMP MAIN_LOOP
VERIFICAR_31:
	MOV R16, R11
	CPI R16, 3
	BREQ SUMAR_MES
	JMP MAIN_LOOP
SUMAR_MES:
	LDI R16, 1
	MOV R10, R16
	CLR R11
	INC R12
	INC R15
	CLR R21
	MOV R16, R12
	CPI R16, 10
	BREQ SUMAR_MES_D
	MOV R16, R15
	CPI R16, 13
	BREQ ANO_NUEVO
	JMP MAIN_LOOP
SUMAR_MES_D:
	LDI R16, 1
	MOV R12, R16
	INC R13
	JMP MAIN_LOOP
ANO_NUEVO:
	LDI R16, 1
	MOV R12 , R16
	LDI R16, 1
	MOV R16, R15
	CLR R13
	JMP  MAIN_LOOP


; AQUI HAY INTERRUPCCONES ****************************************************************
MODOS:
	PUSH R16
	IN R16, SREG
	PUSH R16
	SBIS PINC, PC2
	JMP CAMBIAR_MODO
	JMP SALIR
CAMBIAR_MODO:
	INC R6
	CLR R9
	MOV R16, R6
	CPI R16, 5
	BREQ REINICIAR
	JMP SALIR
REINICIAR:
	CLR R6
SALIR:
	POP R16
	OUT SREG,R16
	POP R16
	RETI	
timmer:
	PUSH R16
	IN R16, SREG
	PUSH R16
	
	LDI R16, 218
	OUT TCNT0, R16
	INC R4
	INC R5
	MOV R16, R4
	CPI R16, 200
	BREQ MIN_C
	JMP SALIR
MIN_C:
	CLR R4
	INC R26
	JMP SALIR
	RETI
	
; AQUI SE ACABAN LAS INTERRUPCIONES ***************************************************************
; EL PRESCALER*************************************************************************************
prescaler1:
	LDI R16, (1<<CS02)|(1<<CS00) ; SE CONFIGURA EL PRESACALER 1024
	OUT TCCR0B, R16
	LDI R16, 218 ; LE CARGO EL VALOR DEL MAXIMO
	OUT TCNT0, R16 ; CARGO VALOR INICAL DEL CONTADPR
	RET
